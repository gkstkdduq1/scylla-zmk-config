## Kconfig
```kconfig
# Behaviors provided by this config repo, built as a Zephyr module.

config ZMK_BEHAVIOR_STATUS_REPORT
    bool "Status report behavior"
    default y
    depends on DT_HAS_ZMK_BEHAVIOR_STATUS_REPORT_ENABLED
    depends on !ZMK_SPLIT || ZMK_SPLIT_ROLE_CENTRAL
    help
      Types the current output endpoint, BLE profile and battery levels as
      text. The Studio RPC cannot report any of that, so the keyboard has to
      volunteer it through the keystrokes it already sends.

if ZMK_BEHAVIOR_STATUS_REPORT

config ZMK_BEHAVIOR_STATUS_REPORT_STACK_SIZE
    int "Status report thread stack size"
    default 1024

endif
```

## dts/bindings/behaviors/zmk,behavior-status-report.yaml
```yaml
# Copyright (c) 2026
# SPDX-License-Identifier: MIT

description: |
  Types out the keyboard's current connection status as text.

  The Studio RPC exposes only core/behaviors/keymap, so a host application has
  no way to ask which endpoint or BLE profile is active. This behavior makes the
  keyboard volunteer the information over the one channel it always has: the
  keystrokes it is already sending.

compatible: "zmk,behavior-status-report"

include: zero_param.yaml

properties:
  tap-ms:
    type: int
    default: 6
    description: How long each synthesized key is held, in milliseconds.
  wait-ms:
    type: int
    default: 6
    description: Gap between synthesized keys, in milliseconds.
```
